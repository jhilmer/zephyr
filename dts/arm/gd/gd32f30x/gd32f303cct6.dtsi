/*
 * Copyright (c) 2021 YuLong Yao <feilongphone@gmail.com>
 *
 * SPDX-License-Identifier: Apache-2.0
 */

#include <mem.h>
#include <gd/gd32f30x/gd32f30x.dtsi>

&flash0 {
	reg = <0x08000000 DT_SIZE_K(256)>;
};

&sram0 {
	reg = <0x20000000 DT_SIZE_K(48)>;
};
