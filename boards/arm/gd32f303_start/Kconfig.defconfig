## boards/arm/gd32f303_start/Kconfig.defconfig
```kconfig
# Copyright (c) 2022, TOKITA Hiroshi <tokita.hiroshi@gmail.com>
# SPDX-License-Identifier: Apache-2.0

if BOARD_GD32F303_START

config BOARD
	default "gd32f303_start"

endif # BOARD_GD32F303_START
```

## boards/arm/gd32f303_start/gd32f303_start_defconfig
```kconfig
# Copyright (c) 2022, TOKITA Hiroshi <tokita.hiroshi@gmail.com>
# SPDX-License-Identifier: Apache-2.0

CONFIG_SOC_SERIES_GD32F30X=y
CONFIG_SOC_GD32F303=y
CONFIG_BOARD_GD32F303_START=y

CONFIG_ARM_MPU=y
CONFIG_HW_STACK_PROTECTION=y

CONFIG_CONSOLE=y
CONFIG_UART_CONSOLE=y
CONFIG_SERIAL=y

CONFIG_GPIO=y
```

## boards/arm/sci_ver13/Kconfig.board
```kconfig
# Copyright (c) 2022, TOKITA Hiroshi <tokita.hiroshi@gmail.com>
# SPDX-License-Identifier: Apache-2.0

config BOARD_SCI_VER13
	bool "SCI VER13"
	depends on SOC_GD32F303
```

## boards/arm/sci_ver13/Kconfig.defconfig
```kconfig
# Copyright (c) 2022, TOKITA Hiroshi <tokita.hiroshi@gmail.com>
# SPDX-License-Identifier: Apache-2.0

if BOARD_SCI_VER13

config BOARD
	default "sci_ver13"

endif # BOARD_SCI_VER13
```

## boards/arm/sci_ver13/sci_ver13_defconfig
```kconfig
# Copyright (c) 2022, TOKITA Hiroshi <tokita.hiroshi@gmail.com>
# SPDX-License-Identifier: Apache-2.0

CONFIG_PM=y

CONFIG_SOC_SERIES_GD32F30X=y
CONFIG_SOC_GD32F303=y
CONFIG_BOARD_SCI_VER13=y

CONFIG_ARM_MPU=y
CONFIG_HW_STACK_PROTECTION=y

CONFIG_CONSOLE=y
CONFIG_UART_CONSOLE=y
CONFIG_SERIAL=y

CONFIG_GPIO=y
CONFIG_GPIO_HOGS=y

CONFIG_DEBUG=y
CONFIG_SOC_LOG_LEVEL_DBG=y
CONFIG_LOG_BACKEND_UART=y

#CONFIG_NETWORKING=y
#CONFIG_NET_SOCKETS=y
#CONFIG_MODEM=y
#CONFIG_MODEM_QUECTEL_BG9X=y
#CONFIG_MODEM_QUECTEL_BG9X_APN="onomondo"

#CONFIG_ENTROPY_GENERATOR=y
#CONFIG_TEST_RANDOM_GENERATOR=y
```

## soc/arm/gd_gd32/gd32f30x/Kconfig.defconfig.series
```kconfig
# Copyright (c) 2021 YuLong Yao <feilongphone@gmail.com>
# SPDX-License-Identifier: Apache-2.0

if SOC_SERIES_GD32F30X

source "soc/arm/gd_gd32/gd32f30x/Kconfig.defconfig.gd32*"

config SOC_SERIES
	default "gd32f30x"

endif # SOC_SERIES_GD32F30X
```

## soc/arm/gd_gd32/gd32f30x/Kconfig.soc
```kconfig
# Copyright (c) 2021 YuLong Yao <feilongphone@gmail.com>
# SPDX-License-Identifier: Apache-2.0

choice
	prompt "GigaDevice GD32F303 MCU Selection"
	depends on SOC_SERIES_GD32F30X

	config SOC_GD32F303
		bool "gd32f303"
endchoice
```
